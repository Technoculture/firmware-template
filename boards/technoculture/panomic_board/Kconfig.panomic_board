## boards/technoculture/panomic_board/Kconfig.panomic_board
```kconfig
# Copyright (c) 2017, Erwin Rol <erwin@erwinrol.com>
# SPDX-License-Identifier: Apache-2.0

config BOARD_PANOMIC_BOARD
  bool "Use Olimex STM32 E407 Board"
	select SOC_STM32F407XG
```

## boards/technoculture/panomic_board/board.yml
```yaml
# Copyright (c) 2024 Nordic Semiconductor ASA
# SPDX-License-Identifier: Apache-2.0

board:
  name: panomic_board
  vendor: technoculture
  socs:
    - name: stm32f407xx
```
